## conf/layer.conf
```bitbake
# We have a conf and classes directory, append to BBPATH
BBPATH .= ":${LAYERDIR}"

BBFILES += "${LAYERDIR}/recipes-*/*/*.bb"

BSP-BASE-VUPLUS := '${@os.path.normpath("${LAYERDIR}/")}'
```

## conf/machine/vuduo.conf
```bitbake
#@TYPE: Machine
#@NAME: Vu+ Duo
#@DESCRIPTION: Machine configuration for the Vu+ Duo

SOC_FAMILY = "bcm7335"
CHIPSET = "bcm7335"

BRAND_OEM = "vuplus"
MACHINE_BRAND = "Vu+"
MACHINE_NAME = "Duo"

MTD_ROOTFS = "mtd0"
MTD_KERNEL = "mtd1"
KERNEL_FILE = "kernel_cfe_auto.bin"
ROOTFS_FILE = "root_cfe_auto.jffs2"

MACHINE_FEATURES += " HDMI textlcd ci fanctrl skins1080 SCART YUV smallflash"

UPDATE_DIR = "duo"
MACHINE_FEATURES += "opera-browser"

require conf/machine/include/vuxxo.inc

MACHINE_KERNEL_PR = "r5"
```

## conf/machine/vuduo2.conf
```bitbake
#@TYPE: Machine
#@NAME: Vu+ Duo2
#@DESCRIPTION: Machine configuration for the Vu+ Duo2

SOC_FAMILY = "bcm7424"
CHIPSET = "bcm7424"

BRAND_OEM = "vuplus"
MACHINE_BRAND = "VU+"
MACHINE_NAME = "Duo²"

MTD_ROOTFS = "mtd0"
MTD_KERNEL = "mtd2"
KERNEL_FILE = "kernel_cfe_auto.bin"
ROOTFS_FILE = "root_cfe_auto.bin"

MACHINE_FEATURES += " HDMI textlcd bwlcd140 ci fan fanctrl skins1080 SCART YUV RCA wol transcoding streamproxy dvbproxy opera-browser blindscan-dvbs blindscan-dvbc dvb-c"
OPENPLI_FEATURES += " kodi"

UPDATE_DIR = "duo2"

require conf/machine/include/vuxxo2.inc

IMAGE_INSTALL_append += "\
	vuplus-initrd-${MACHINE} \
	enigma2-plugin-extensions-lcd4linux \
	vuplus-coldboot \
"

EXTRA_IMAGEDEPENDS += "\
	enigma2-plugin-systemplugins-manualfancontrol \
"

MKFS_UBI_MAX_ERASE_BLK_COUNT = "8192"
FORCE_REBOOT_OPTION = "reboot"

MACHINE_KERNEL_PR = "r1"
```

## conf/machine/vuduo4k.conf
```bitbake
#@TYPE: Machine
#@NAME: Vu+ Duo4k
#@DESCRIPTION: Machine configuration for the Vu+ Duo4k

SOC_FAMILY = "bcm7376"
CHIPSET = "bcm7376"

BRAND_OEM = "vuplus"
MACHINE_BRAND = "Vu+"
MACHINE_NAME = "Duo4K"

MTD_ROOTFS = "mmcblk0p9"
MTD_KERNEL = "mmcblk0p6"
KERNEL_FILE = "kernel_auto.bin"
ROOTFS_FILE = "rootfs.tar.bz2"
MTD_BLACK  = "mmcblk0"

MACHINE_FEATURES += " HDMI HDMI-IN-FHD skins1080 displayvfd kexecmb colorlcd480 quadpip ci dvb-c blindscan-dvbc blindscan-dvbs fcc emmc webkithbbtv ctrlrc transcoding streamproxy dvbproxy mmc bluetooth bcmwifi chromiumos hdmi-in-helper vu-eglfs"
OPENPLI_FEATURES += " kodi"

UPDATE_DIR = "duo4k"

require conf/machine/include/vuxxo4k.inc

DVBMEDIASINK_CONFIG = "--with-dtsdownmix --with-dts --with-pcm --with-eac3 --with-amr --with-wmv --with-vb6 --with-vb8 --with-vb9 --with-spark --with-h265"

IMAGE_INSTALL_append += "\
	vuplus-initrd-${MACHINE} \
	enigma2-plugin-systemplugins-bluetoothsetup \
	vuplus-bluetooth-util-${MACHINE} \
	vuplus-wifi-util-${MACHINE} \
	"

PREFERRED_VERSION_mmc-utils = "0.2"
PREFERRED_VERSION_linux-${MACHINE} = "4.1.45"
PREFERRED_VERSION_hmp-usb-dvb-t2-c-arm = "V160430"

FORCE_REBOOT_OPTION = "reboot"

MACHINE_KERNEL_PR = "r0"

IMAGE_FSTYPES =+ "ext4"
```

## conf/machine/vusolo.conf
```bitbake
#@TYPE: Machine
#@NAME: Vu+ Solo
#@DESCRIPTION: Machine configuration for the Vu+ Solo

SOC_FAMILY = "bcm7325"
CHIPSET = "bcm7325"

BRAND_OEM = "vuplus"
MACHINE_BRAND = "Vu+"
MACHINE_NAME = "Solo"

MTD_ROOTFS = "mtd0"
MTD_KERNEL = "mtd1"
KERNEL_FILE = "kernel_cfe_auto.bin"
ROOTFS_FILE = "root_cfe_auto.jffs2"

MACHINE_FEATURES += " HDMI textlcd ci fanctrl skins1080 SCART smallflash"

UPDATE_DIR = "solo"

require conf/machine/include/vuxxo.inc

MACHINE_KERNEL_PR = "r5"
```

## conf/machine/vusolo2.conf
```bitbake
#@TYPE: Machine
#@NAME: Vu+ Solo2
#@DESCRIPTION: Machine configuration for the Vu+ Solo2

SOC_FAMILY = "bcm7356"
CHIPSET = "bcm7356"

BRAND_OEM = "vuplus"
MACHINE_BRAND = "VU+"
MACHINE_NAME = "Solo²"

MTD_ROOTFS = "mtd0"
MTD_KERNEL = "mtd2"
KERNEL_FILE = "kernel_cfe_auto.bin"
ROOTFS_FILE = "root_cfe_auto.bin"

MACHINE_FEATURES += " HDMI textlcd ci fanctrl transcoding streamproxy skins1080 SCART RCA transcoding blindscan-dvbs"
OPENPLI_FEATURES += " kodi"

UPDATE_DIR = "solo2"

require conf/machine/include/vuxxo2.inc

IMAGE_INSTALL_append += "vuplus-initrd-${MACHINE}"

EXTRA_IMAGEDEPENDS += " \
	enigma2-plugin-systemplugins-manualfancontrol \
"

MKFS_UBI_MAX_ERASE_BLK_COUNT = "4096"
FORCE_REBOOT_OPTION = "reboot"

MACHINE_KERNEL_PR = "r2"
```

## conf/machine/vusolose.conf
```bitbake
#@TYPE: Machine
#@NAME: Vu+ SoloSE
#@DESCRIPTION: Machine configuration for the Vu+ SoloSe

SOC_FAMILY = "bcm7241"
CHIPSET = "bcm7241"

BRAND_OEM = "vuplus"
MACHINE_BRAND = "VU+"
MACHINE_NAME = "Solo SE"

MTD_ROOTFS = "mtd0"
MTD_KERNEL = "mtd2"
KERNEL_FILE = "kernel_cfe_auto.bin"
ROOTFS_FILE = "root_cfe_auto.bin"

MACHINE_FEATURES += " HDMI textlcd ci fan fanctrl ctrlrc vupluszap opera-browser transcoding streamproxy skins1080 RCA transcoding dvbproxy blindscan-dvbs dvb-c blindscan-dvbc"
OPENPLI_FEATURES += " kodi"

UPDATE_DIR = "solose"

require conf/machine/include/vuxxo2.inc

IMAGE_INSTALL_append += "\
	vuplus-initrd-${MACHINE} \
"

MKFS_UBI_MAX_ERASE_BLK_COUNT = "4096"
FORCE_REBOOT_OPTION = "force"

MACHINE_KERNEL_PR = "r1"
```

## conf/machine/vuultimo.conf
```bitbake
#@TYPE: Machine
#@NAME: Vu+ Ultimo
#@DESCRIPTION: Machine configuration for the Vu+ Ultimo

SOC_FAMILY = "bcm7413"
CHIPSET = "bcm7413"

BRAND_OEM = "vuplus"
MACHINE_BRAND = "Vu+"
MACHINE_NAME = "Ultimo"

MTD_ROOTFS = "mtd0"
MTD_KERNEL = "mtd1"
KERNEL_FILE = "kernel_cfe_auto.bin"
ROOTFS_FILE = "root_cfe_auto.jffs2"

MACHINE_FEATURES += " HDMI SCART RCA YUV bwlcd255 ci fan dvb-c blindscan-dvbc blindscan-dvbs ctrlrc opera-browser skins1080 fanctrl"

UPDATE_DIR = "ultimo"

require conf/machine/include/vuxxo.inc

EXTRA_IMAGEDEPENDS += "\
	enigma2-plugin-systemplugins-manualfancontrol \
	enigma2-plugin-systemplugins-firmwareupgrade \
	enigma2-plugin-systemplugins-remotecontrolcode \
	enigma2-plugin-systemplugins-ledbrightnesssetup \
	"

MACHINE_KERNEL_PR = "r5"
```

## conf/machine/vuultimo4k.conf
```bitbake
#@TYPE: Machine
#@NAME: Vu+ Ultimo4k
#@DESCRIPTION: Machine configuration for the Vu+ Ultimo4k

SOC_FAMILY = "bcm7444"
CHIPSET = "bcm7444"

BRAND_OEM = "vuplus"
MACHINE_BRAND = "VU+"
MACHINE_NAME = "Ultimo 4K"

MTD_ROOTFS = "mmcblk0p4"
MTD_KERNEL = "mmcblk0p1"
KERNEL_FILE = "kernel_auto.bin"
ROOTFS_FILE = "rootfs.tar.bz2"
MTD_BLACK  = "mmcblk0"

MACHINE_FEATURES += " HDMI HDMI-IN-FHD hdmi-in-helper displayvfd kexecmb colorlcd800 quadpip ci dvb-c blindscan-dvbc blindscan-dvbs fcc emmc bcmwifi webkithbbtv ctrlrc transcoding streamproxy dvbproxy mmc bluetooth chromiumos vu-eglfs"
OPENPLI_FEATURES += " kodi"

UPDATE_DIR = "ultimo4k"

require conf/machine/include/vuxxo4k.inc

DVBMEDIASINK_CONFIG = "--with-dtsdownmix --with-dts --with-pcm --with-eac3 --with-amr --with-wmv --with-vb6 --with-vb8 --with-vb9 --with-spark --with-h265"

IMAGE_INSTALL_append += "\
	vuplus-initrd-${MACHINE} \
	enigma2-plugin-systemplugins-bluetoothsetup \
	vuplus-bluetooth-util-${MACHINE} \
	vuplus-wifi-util-${MACHINE} \
	"

FORCE_REBOOT_OPTION = "reboot"

MACHINE_KERNEL_PR = "r1"

IMAGE_FSTYPES =+ "ext4"
```

## conf/machine/vuuno.conf
```bitbake
#@TYPE: Machine
#@NAME: Vu+ Uno
#@DESCRIPTION: Machine configuration for the Vu+ Uno

SOC_FAMILY = "bcm7413"
CHIPSET = "bcm7413"

BRAND_OEM = "vuplus"
MACHINE_BRAND = "Vu+"
MACHINE_NAME = "Uno"

MTD_ROOTFS = "mtd0"
MTD_KERNEL = "mtd1"
KERNEL_FILE = "kernel_cfe_auto.bin"
ROOTFS_FILE = "root_cfe_auto.jffs2"

MACHINE_FEATURES += " HDMI SCART RCA textlcd ci fan dvb-c blindscan-dvbc blindscan-dvbs ctrlrc opera-browser skins1080 smallflash fanctrl"

UPDATE_DIR = "uno"

require conf/machine/include/vuxxo.inc

EXTRA_IMAGEDEPENDS += "\
	enigma2-plugin-systemplugins-manualfancontrol \
	enigma2-plugin-systemplugins-fpgaupgrade \
	enigma2-plugin-systemplugins-remotecontrolcode \
"

MACHINE_KERNEL_PR = "r5"
```

## conf/machine/vuzero.conf
```bitbake
#@TYPE: Machine
#@NAME: Vu+ Zero
#@DESCRIPTION: Machine configuration for the Vu+ Zero

SOC_FAMILY = "bcm73625"
CHIPSET = "bcm73625"

BRAND_OEM = "vuplus"
MACHINE_BRAND = "Vu+"
MACHINE_NAME = "zero"

MTD_ROOTFS = "mtd0"
MTD_KERNEL = "mtd2"
KERNEL_FILE = "kernel_cfe_auto.bin"
ROOTFS_FILE = "root_cfe_auto.bin"

MACHINE_FEATURES += " HDMI vupluszap fan fanctrl skins1080 AV_JACK wol opera-browser blindscan-dvbs"
OPENPLI_FEATURES += " kodi"

UPDATE_DIR = "zero"

require conf/machine/include/vuxxo2.inc

IMAGE_INSTALL_append += "\
	vuplus-initrd-${MACHINE} \
	"

DVBMEDIASINK_CONFIG += " --with-h265"
MKFS_UBI_MAX_ERASE_BLK_COUNT = "4096"
FORCE_REBOOT_OPTION = "force"

MACHINE_KERNEL_PR = "r1"
```

## conf/machine/vuzero4k.conf
```bitbake
#@TYPE: Machine
#@NAME: Vu+ Zero4K
#@DESCRIPTION: Machine configuration for the Vu+ Zero4K

SOC_FAMILY = "bcm72604"
CHIPSET = "bcm72604"

BRAND_OEM = "vuplus"
MACHINE_BRAND = "Vu+"
MACHINE_NAME = "Zero 4K"

MTD_ROOTFS = "mmcblk07"
MTD_KERNEL = "mmcblk0p4"
KERNEL_FILE = "kernel_auto.bin"
ROOTFS_FILE = "rootfs.tar.bz2"
MTD_BLACK  = "mmcblk0"

MACHINE_FEATURES += " HDMI kexecmb ci dvb-c blindscan-dvbc blindscan-dvbs emmc webkithbbtv ctrlrc dvbproxy mmc bluetooth chromiumos vu-eglfs"
OPENPLI_FEATURES += " kodi"

UPDATE_DIR = "zero4k"

require conf/machine/include/vuxxo4k.inc

DVBMEDIASINK_CONFIG = "--with-dtsdownmix --with-dts --with-pcm --with-eac3 --with-amr --with-wmv --with-vb6 --with-vb8 --with-vb9 --with-spark --with-h265"

IMAGE_INSTALL_append += "\
	vuplus-initrd-${MACHINE} \
	enigma2-plugin-systemplugins-bluetoothsetup \
	vuplus-bluetooth-util-${MACHINE} \
	"

FORCE_REBOOT_OPTION = "force"

MACHINE_KERNEL_PR = "r0"

IMAGE_FSTYPES =+ "ext4"

PREFERRED_VERSION_linux-${MACHINE} = "4.1.20"
PREFERRED_VERSION_hmp-usb-dvb-t2-c-arm = "V160430"
```
